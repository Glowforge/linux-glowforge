## Documentation/devicetree/bindings/pwm/imx-pwm.txt
```
Freescale i.MX PWM controller

Required properties:
- compatible: should be "fsl,<soc>-pwm"
- reg: physical base address and length of the controller's registers
- #pwm-cells: should be 2. See pwm.txt in this directory for a description of
  the cells format.
- interrupts: The interrupt for the pwm controller

Optional properties:
- fsl,extra-prescale: additional frequency divider. The effective output
  period is equal to period_ns times this value. Defaults to 1. Can be used to
  decrease the signal output frequency without affecting the range of valid
  duty cycle values.

Example:

pwm1: pwm@53fb4000 {
	#pwm-cells = <2>;
	compatible = "fsl,imx53-pwm", "fsl,imx27-pwm";
	reg = <0x53fb4000 0x4000>;
	interrupts = <61>;
};
```

## Documentation/devicetree/bindings/regulator/userspace-consumer.txt
```
Userspace consumer regulators

Required properties:
- compatible		: Must be "reg-userspace-consumer".
- regulator-supplies: Supply names for this regulator. This can be
	multiple strings.

Optional properties:
- regulator-name: Name of the consumer line.
- regulator-boot-on: Enable regulator on booting.

With all supply names, there should be <supply-name>-supply to pass regulators
handle as defined in regulator.txt.

Example:

	userspace-consumer {
		compatible = "reg-userspace-consumer";

		regulator-name = "gps-consumer";
		regulator-boot-on;
		regulator-supplies = "vdd", "vcc", "vdd-3v3";
		vdd-supply = <&reg1>;
		vcc-supply = <&reg2>;
		vdd-3v3-supply = <&reg3>;
	};
```
